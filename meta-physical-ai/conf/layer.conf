## meta-physical-ai/conf/layer.conf
```bitbake
# meta-physical-ai — Custom Yocto layer for Physical AI on Jetson Orin
#
# SPDX-License-Identifier: MIT

# Layer root
BBPATH .= ":${LAYERDIR}"

# Recipe search paths
BBFILES += " \
    ${LAYERDIR}/recipes-*/*/*.bb \
    ${LAYERDIR}/recipes-*/*/*.bbappend \
    ${LAYERDIR}/recipes-*/*/*/*.bb \
    ${LAYERDIR}/recipes-*/*/*/*.bbappend \
"

BBFILE_COLLECTIONS += "physical-ai"
BBFILE_PATTERN_physical-ai = "^${LAYERDIR}/"
BBFILE_PRIORITY_physical-ai = "10"

LAYERDEPENDS_physical-ai = "core tegra"
LAYERSERIES_COMPAT_physical-ai = "scarthgap"
```
